## application-1/main/Kconfig.projbuild
```kconfig
menu "Internet radio configuration"

    config RADIO_WIFI_SSID
        string "Wi-Fi SSID"
        default ""
        help
            SSID used by the Internet radio. Configure this locally with
            menuconfig; do not commit generated sdkconfig files.

    config RADIO_WIFI_PASSWORD
        string "Wi-Fi password"
        default ""
        help
            Password used by the Internet radio. It is never written to logs.

    config RADIO_WIFI_MAX_BACKOFF_SECONDS
        int "Maximum Wi-Fi reconnect delay (seconds)"
        range 1 300
        default 30

endmenu
```

## controller/main/Kconfig.projbuild
```kconfig
menu "LC72130 network monitor"

config LC72130_WIFI_SSID
    string "Wi-Fi SSID"
    default "Legomanhouse"

config LC72130_WIFI_PASSWORD
    string "Wi-Fi password"
    default "barcelona"

config LC72130_RADIO_UART_TX_GPIO
    int "Radio ESP UART TX GPIO"
    default 6
    range 0 48

config LC72130_RADIO_UART_RX_GPIO
    int "Radio ESP UART RX GPIO"
    default 5
    range 0 48

config LC72130_RADIO_UART_BAUD
    int "Radio ESP UART baud rate"
    default 115200

config LC72130_OTA_TOKEN
    string "OTA update shared secret token"
    default "change-me-ota-token"
    help
        Required as the X-OTA-Token header on POST /api/ota. Change this from
        the default before deploying on any shared network.

config LC72130_RDS_UTC_OFFSET_HALF_HOURS
    int "RDS Clock Time (4A) local UTC offset, in half-hour units"
    default 4
    range -28 28
    help
        Local time offset broadcast in the RDS Group 4A Clock Time field, in
        units of 30 minutes. Default 4 = +2:00 (Europe/Spain CEST). Use 2 for
        CET (+1:00) during winter, or adjust for another time zone.

endmenu
```

## controller/sdkconfig.defaults
```kconfig
# ESP-IDF SDK Configuration

# Board and chip
CONFIG_IDF_TARGET="esp32s3"
CONFIG_IDF_TARGET_ESP32S3=y

# FreeRTOS
CONFIG_FREERTOS_MAX_TASK_NAME_LEN=32

# Logging
CONFIG_LOG_DEFAULT_LEVEL=3
CONFIG_LOG_DEFAULT_LEVEL_INFO=y

# Serial
CONFIG_ESP_CONSOLE_USB_SERIAL_JTAG=y
CONFIG_ESP_CONSOLE_SECONDARY_USB_SERIAL_JTAG=y

# Timer
CONFIG_ESP_TIMER_IMPL_SYSTIMER=y

# GPIO
CONFIG_GPIO_CTRL_FUNC_IN_IRAM=y

# Driver
CONFIG_RMT_ENABLE_BY_DEFAULT=y

# Performance tuning
CONFIG_FREERTOS_TICK_RATE_HZ=1000

# Watchdog
CONFIG_TASK_WDT_ENABLE=y
CONFIG_TASK_WDT_TIMEOUT_S=15

# NVS
CONFIG_NVS_ENCRYPTION=n
```

## radio/esp32radio/Kconfig.projbuild
```kconfig
menu "Radio controller UART"

config RADIO_CONTROLLER_UART_RX_GPIO
    int "Radio ESP UART RX GPIO"
    range 0 48
    default 40
    help
        Receives controller GPIO6 (TX). GPIO40 is free on the ESP32-S3 N16R8
        radio board configuration.

config RADIO_CONTROLLER_UART_TX_GPIO
    int "Radio ESP UART TX GPIO"
    range 0 48
    default 41
    help
        Transmits to controller GPIO5 (RX). GPIO41 is free on the ESP32-S3
        N16R8 radio board configuration.

config RADIO_CONTROLLER_AUDIO_RDY_GPIO
    int "Radio ESP AUDIO_RDY GPIO"
    range 0 48
    default 42
    help
        Active-high output to the controller. It remains low during application
        initialization and rises after idle service is ready and the initial
        UART status snapshot has been transmitted.

endmenu
```
